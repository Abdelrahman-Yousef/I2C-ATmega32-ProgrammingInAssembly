;
; I2C_Master_Transmitter.asm
;
; Created: 12/26/2023 11:00:27 AM
; Author : Options
;


; Replace with your application code

.INCLUDE "m32def.inc"

.ORG 0x00
MAIN:
LDI R16,HIGH(RAMEND)
OUT SPH,R16
LDI R16,LOW(RAMEND)
OUT SPL,R16

CALL I2C_INIT

CALL I2C_START
CALL I2C_STATUS
CPI R16,0x08
BRNE LOOP

LDI R16, (0x68 << 1)
CALL I2C_WRITE
CALL I2C_STATUS
CPI R16,0x18
BRNE ERROR

LDI R16,0xF0
CALL I2C_WRITE
CALL I2C_STATUS
CPI R16,0x28
BRNE ERROR

CALL I2C_STOP

LOOP: RJMP LOOP

ERROR:
CALL I2C_STOP
RJMP LOOP


.ORG 0x100
I2C_INIT:
LDI R16,0x00
OUT TWSR,R16
LDI R16,0x20
OUT TWBR,R16
LDI R16,1 << TWEN
OUT TWCR,R16
RET

I2C_START:
LDI R16,(1 << TWEN) | (1 << TWSTA) | (1 << TWINT)
OUT TWCR,R16
L1:
IN R16,TWCR
SBRS R16,TWINT
RJMP L1
RET

I2C_WRITE:
OUT TWDR,R16
LDI R16,(1 << TWEN) | (1 << TWINT)
OUT TWCR,R16
L2:
IN R16,TWCR
SBRS R16,TWINT
RJMP L2
RET

I2C_STOP:
LDI R16,(1 << TWEN) | (1 << TWSTO) | (1 << TWINT)
OUT TWCR,R16
RET

I2C_STATUS:
IN R16,TWSR
ANDI R16,0xFC
RET
