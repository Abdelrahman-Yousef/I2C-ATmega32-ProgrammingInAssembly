;
; I2C_Master_Receiver.asm
;
; Created: 12/27/2023 9:07:46 AM
; Author : Options
;


; Replace with your application code

.INCLUDE "m32def.inc"

.ORG 0x00
MAIN:
LDI R16,HIGH(RAMEND)
OUT SPH,R16
LDI R16,LOW(RAMEND)
OUT SPL,R16

LDI R16,0xFF
OUT DDRA,R16

CALL I2C_INIT

CALL I2C_START
CALL I2C_STATUS
CPI R17,0x08
BRNE LOOP

LDI R16, (0x68 << 1) | (0x01)
CALL I2C_WRITE
CALL I2C_STATUS
CPI R17,0x40
BRNE ERROR

CALL I2C_READ_WITH_NACK
CALL I2C_STATUS
CPI R17,0x58
BRNE ERROR

OUT PORTA,R16

CALL I2C_STOP

LOOP: RJMP LOOP

ERROR:
CALL I2C_STOP
RJMP LOOP


.ORG 0x100
I2C_INIT:
LDI R16,0x00
OUT TWSR,R16
LDI R16,0x20
OUT TWBR,R16
LDI R16,1 << TWEN
OUT TWCR,R16
RET

I2C_START:
LDI R16,(1 << TWEN) | (1 << TWSTA) | (1 << TWINT)
OUT TWCR,R16
L1:
IN R16,TWCR
SBRS R16,TWINT
RJMP L1
RET

I2C_WRITE:
OUT TWDR,R16
LDI R16,(1 << TWEN) | (1 << TWINT)
OUT TWCR,R16
L2:
IN R16,TWCR
SBRS R16,TWINT
RJMP L2
RET

I2C_STOP:
LDI R16,(1 << TWEN) | (1 << TWSTO) | (1 << TWINT)
OUT TWCR,R16
RET

I2C_READ_WITH_NACK:
LDI R16,(1 << TWEN) | (1 << TWINT)
OUT TWCR,R16
L3:
IN R16,TWCR
SBRS R16,TWINT
RJMP L3
IN R16,TWDR
RET

I2C_READ_WITH_ACK:
LDI R16,(1 << TWEN) | (1 << TWINT) | (1 << TWEA)
OUT TWCR,R16
L4:
IN R16,TWCR
SBRS R16,TWINT
RJMP L4
IN R16,TWDR
RET

I2C_STATUS:
IN R17,TWSR
ANDI R17,0xFC
RET