;
; I2C_Slave_Transmitter.asm
;
; Created: 12/27/2023 9:12:48 AM
; Author : Options
;


; Replace with your application code

.INCLUDE "m32def.inc"

.ORG 0x00
MAIN:
LDI R16,HIGH(RAMEND)
OUT SPH,R16
LDI R16,LOW(RAMEND)
OUT SPL,R16

CALL I2C_INIT

CALL I2C_LISTEN
CALL I2C_STATUS
CPI R16,0xA8
BRNE ERROR

LDI R16,'G'
CALL I2C_WRITE
CALL I2C_STATUS
CPI R16,0xC0
BRNE ERROR

LDI R16,(1 << TWINT) | (1 << TWEN) | (1 << TWEA)
OUT TWCR,R16

LOOP: RJMP LOOP

ERROR: RJMP LOOP


.ORG 0x100
I2C_INIT:
LDI R16,(0x68 << 1)
OUT TWAR,R16
LDI R16,(1 << TWEN)
OUT TWCR,R16
LDI R16,(1 << TWEN) | (1 << TWINT) | (1 << TWEA)
OUT TWCR,R16
RET

I2C_LISTEN:
IN R16,TWCR
SBRS R16,TWINT
RJMP I2C_LISTEN
RET

I2C_READ:
LDI R16,(1 << TWINT) | (1 << TWEN) | (1 << TWEA)
OUT TWCR,R16
L1:
IN R16,TWCR
SBRS R16,TWINT
RJMP L1
IN R16,TWDR
RET

I2C_WRITE:
OUT TWDR,R16
LDI R16,(1 << TWEN) | (1 << TWINT) | (1 << TWEA)
OUT TWCR,R16
L2:
IN R16,TWCR
SBRS R16,TWINT
RJMP L2
RET

I2C_STATUS:
IN R16,TWSR
ANDI R16,0xFC
RET